// SPDX-License-Identifier: BSD-3-Clause
/*
 * Copyright (c) Qualcomm Technologies, Inc. and/or its subsidiaries.
 */

#include "ravelin.dtsi"
/ {
	model = "Qualcomm Technologies, Inc. RavelinP";
	compatible = "qcom,ravelinp";
	qcom,msm-id = <602 0x10000>;
};
