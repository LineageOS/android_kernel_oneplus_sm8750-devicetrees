// SPDX-License-Identifier: BSD-3-Clause

/*
 * Copyright (c) Qualcomm Technologies, Inc. and/or its subsidiaries.
 */

/dts-v1/;
/plugin/;

#include "ravelin-nfc-common.dtsi"
/ {
        model = "Qualcomm Technologies, Inc. Montague HSP IDP";
        compatible =  "qcom,montague-idp", "qcom,montague", "qcom,idp", "qcom,montague-qmb";
        qcom,msm-id = <581 0x10000>;
        qcom,board-id = <33 0>,<34 0>, <0x1000B 0>, <34 0x601>,  <0x1000B 0x600>, <34 2> , <0x10022 0x4> , <0x10022 0x3>;
};

