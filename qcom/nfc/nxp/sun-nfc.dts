// SPDX-License-Identifier: BSD-3-Clause

/*
 * Copyright (c) Qualcomm Technologies, Inc. and/or its subsidiaries.
 */

/dts-v1/;
/plugin/;

#include "sun-nfc-pinctrl.dtsi"
/ {
        model = "Qualcomm Technologies, Inc. Sun SoC";
        compatible = "qcom,sun";
        qcom,msm-id = <618 0x10000>, <618 0x20000>, <639 0x10000>, <639 0x20000>,
		      <705 0x10000>, <705 0x20000>, <706 0x10000>, <706 0x20000>;
        qcom,board-id = <0 0>;
};
