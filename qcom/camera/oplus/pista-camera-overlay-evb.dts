/dts-v1/;
/plugin/;

#include <dt-bindings/clock/qcom,gcc-sun.h>
#include <dt-bindings/clock/qcom,camcc-sun.h>
#include <dt-bindings/clock/qcom,cambistmclkcc-sun.h>
#include <dt-bindings/interconnect/qcom,sun.h>
#include <dt-bindings/interrupt-controller/arm-gic.h>
#include <dt-bindings/regulator/qcom,rpmh-regulator-levels.h>

#include <dt-bindings/oplus/hw-id.h>
#include "../sun-camera.dtsi"
#include "pista_camera_overlay_common_evb.dtsi"
/ {
	model = "Qualcomm Technologies, Inc. Sun Pista_EVB";
	compatible = "qcom,sun-mtp", "qcom,sun", "qcom,mtp";
	oplus,project-id = <24600 24670 24671>;
	oplus,hw-id = <OPLUS_EVB1 OPLUS_EVB2 OPLUS_EVB3>;
};
