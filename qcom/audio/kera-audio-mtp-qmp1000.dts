// SPDX-License-Identifier: BSD-3-Clause
/*
 * Copyright (c) Qualcomm Technologies, Inc. and/or its subsidiaries.
 */

/dts-v1/;
/plugin/;

#include "kera-audio-mtp-qmp1000.dtsi"

/ {
	model = "Qualcomm Technologies, Inc. Kera MTP QMP1000";
	compatible = "qcom,kera-mtp", "qcom,kera", "qcom,kerap-mtp", "qcom,kerap",
			"qcom,mtp", "qcom,kerap-qmb", "qcom,kerap-qna";
	qcom,msm-id = <686 0x10000>, <659 0x10000>, <720 0x10000>, <721 0x10000>;
	qcom,board-id = <0x30008 0>, <0x30008 1>;
};

