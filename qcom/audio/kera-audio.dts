// SPDX-License-Identifier: BSD-3-Clause
/*
 * Copyright (c) Qualcomm Technologies, Inc. and/or its subsidiaries.
 */

/dts-v1/;
/plugin/;

#include <dt-bindings/clock/qcom,gcc-kera.h>
#include <dt-bindings/interrupt-controller/arm-gic.h>
#include <dt-bindings/interconnect/qcom,kera.h>
#include <dt-bindings/regulator/qcom,rpmh-regulator-levels.h>

#include "kera-audio.dtsi"

/ {
	model = "Qualcomm Technologies, Inc. kera";
	compatible = "qcom,kera", "qcom,kerap-qmb", "qcom,kerap-qna";
	qcom,msm-id = <686 0x10000>, <659 0x10000>, <720 0x10000>, <721 0x10000>,
			<731 0x10000>, <732 0x10000>;
	qcom,board-id = <0 0>;
};
