// SPDX-License-Identifier: BSD-3-Clause
/*
 * Copyright (c) Qualcomm Technologies, Inc. and/or its subsidiaries.
 */

/dts-v1/;
/plugin/;

#include "kera-audio-rcm-orne.dtsi"
/ {
	model = "Qualcomm Technologies, Inc. Kuna RCM+ORNE";
	compatible = "qcom,kera-rcm", "qcom,kera", "qcom,kerap-rcm", "qcom,kerap",
			"qcom,rcm", "qcom,kerap-qmb", "qcom,kerap-qna";
	qcom,msm-id = <686 0x10000>, <659 0x10000>, <720 0x10000>, <721 0x10000>,
			<731 0x10000>, <732 0x10000>;
	qcom,board-id = <0x10015 0>, <0x20015 0>, <0x30015 0>, <0x30015 1>,
			<0x10015 1>, <0x20015 1>;
};
