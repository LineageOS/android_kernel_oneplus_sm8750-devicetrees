// SPDX-License-Identifier: BSD-3-Clause
/*
 * Copyright (c) Qualcomm Technologies, Inc. and/or its subsidiaries.
 */

/dts-v1/;

#include "montague-cqm-fp3.dtsi"

/ {
	model = "Qualcomm Technologies, Inc. Montague-CQM-FP3 SoC";
	compatible = "qcom,montague";
	qcom,board-id = <0 0>;
	qcom,msm-id = <773 0x10000>;
	qcom,softsku-id = <3>;
};

&pcie0 {
	status = "okay";
};

&pcie0_msi {
	status = "okay";
};
