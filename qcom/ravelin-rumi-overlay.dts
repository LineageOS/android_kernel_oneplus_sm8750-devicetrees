// SPDX-License-Identifier: BSD-3-Clause
/*
 * Copyright (c) Qualcomm Technologies, Inc. and/or its subsidiaries.
 */

/dts-v1/;
/plugin/;

#include "ravelin-rumi.dtsi"

/ {
	model = "Qualcomm Technologies, Inc. Ravelin RUMI";
	compatible = "qcom,ravelin-rumi", "qcom,ravelin", "qcom,rumi", "qcom,montague-qmb";
	qcom,msm-id = <568 0x10000>, <773 0x10000>, <774 0x10000>, <734 0x10000>;
	qcom,board-id = <0x1000F 0>;
};

