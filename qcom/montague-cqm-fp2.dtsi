// SPDX-License-Identifier: BSD-3-Clause
/*
 * Copyright (c) Qualcomm Technologies, Inc. and/or its subsidiaries.
 */

#include "montague.dtsi"

/ {
	model = "Qualcomm Technologies, Inc. Montague-CQM-FP2 SoC";
	compatible = "qcom,montague";
};
