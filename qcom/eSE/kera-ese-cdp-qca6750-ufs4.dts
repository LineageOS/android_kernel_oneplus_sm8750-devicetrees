// SPDX-License-Identifier: BSD-3-Clause
/*
 * Copyright (c) 2024 Qualcomm Innovation Center, Inc. All rights reserved.
 */

/dts-v1/;
/plugin/;

#include "kera-ese-common.dtsi"

/ {
	model = "Qualcomm Technologies, Inc. Kera CDP + QCA6750 + UFS4.0";
	compatible = "qcom,kera-cdp", "qcom,kera", "qcom,kerap-cdp", "qcom,kerap",
			"qcom,cdp";

	qcom,msm-id = <686 0x10000>, <659 0x10000>, <731 0x10000>, <732 0x10000>;
	qcom,board-id = <0x40001 0>;
};
