// SPDX-License-Identifier: BSD-3-Clause

/*
 * Copyright (c) Qualcomm Technologies, Inc. and/or its subsidiaries.
 */

#include "chora-wcn7750.dtsi"

&icnss2 {
	bt-en-gpio = <0 1 1 1 2 0 1 4 0 0 0 255 0 0 1 1>;

};

