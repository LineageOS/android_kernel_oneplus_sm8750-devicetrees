// SPDX-License-Identifier: BSD-3-Clause

/*
 * Copyright (c) Qualcomm Technologies, Inc. and/or its subsidiaries.
 */

/dts-v1/;
/plugin/;

#include "monaco-gh-vm-cnss.dtsi"

/ {
	model = "Qualcomm Technologies, Inc. Monaco IVI ADAS QAM Gunyah VM";
	compatible = "qcom,monaco", "qcom,qam";
	qcom,msm-id = <606 0x10000>;
	qcom,board-id = <0x10019 0x0>;
};
