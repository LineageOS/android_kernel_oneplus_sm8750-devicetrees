// SPDX-License-Identifier: BSD-3-Clause

/*
 * Copyright (c) Qualcomm Technologies, Inc. and/or its subsidiaries.
 */

/dts-v1/;
/plugin/;

#include "yupik-qca6750-cnss.dtsi"

/ {
	model = "Qualcomm Technologies, Inc. YUPIK-IOT QRD";
	compatible = "qcom,yupik-iot-qrd", "qcom,yupik-iot", "qcom,qrd";
	qcom,msm-id = <475 0x10000>, <497 0x10000>, <498 0x10000>, <515 0x10000>, <575 0x10000>, <576 0x10000>;
	qcom,board-id = <0x1000B 0>, <34 0>, <0x010020 1>, <0x010020 2>, <0x010020 4>, <0x010020 5>, <0x100020 0xC>;
};
