// SPDX-License-Identifier: BSD-3-Clause

/*
 * Copyright (c) Qualcomm Technologies, Inc. and/or its subsidiaries.
 */

/dts-v1/;
/plugin/;

#include "x1e80100-kiwi-cnss.dtsi"

/ {
	model = "Qualcomm Technologies, Inc. X1E80100 QCB";
	compatible = "qcom,x1e80100-qcb", "qcom,x1e80100", "qcom,qcb";
	qcom,msm-id = <0x22b 0x10000>, <0x22b 0x20000>;
	qcom,board-id = <0x2B 0x0>;
};
