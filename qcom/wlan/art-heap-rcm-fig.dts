// SPDX-License-Identifier: BSD-3-Clause
/*
 * Copyright (c) Qualcomm Technologies, Inc. and/or its subsidiaries.
 */

/dts-v1/;
/plugin/;

#include "art-heap-fig-cnss.dtsi"

/ {
	model = "Qualcomm Technologies, Inc. Arth RCM + Fig WLAN";
	compatible = "qcom,pebble-rcm", "qcom,arth-rcm", "qcom,rcm", "qcom,arth", "qcom,pebble";
	qcom,msm-id = <760 0x10000>;
	qcom,board-id = <0x10015 0x0>;
};
