// SPDX-License-Identifier: BSD-3-Clause
/*
 * Copyright (c) Qualcomm Technologies, Inc. and/or its subsidiaries.
 */

/dts-v1/;
/plugin/;

#include "bourtzi-adrastea.dtsi"

/ {
	model = "Qualcomm Technologies, Inc. Bourtzi QRD + WCN3998 + tioman";
	compatible = "qcom,bourtzi-qrd", "qcom,bourtzip-qrd", "qcom,bourtzi", "qcom,bourtzip", "qcom,qrd";
	qcom,msm-id = <776 0x10000>, <777 0x10000>;
	qcom,board-id = <0x1000b 0x0>;
};
