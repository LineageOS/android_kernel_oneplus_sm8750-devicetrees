// SPDX-License-Identifier: BSD-3-Clause
/*
 * Copyright (c) Qualcomm Technologies, Inc. and/or its subsidiaries.
 */

/dts-v1/;
/plugin/;

#include "pebble-peach-cnss.dtsi"

/ {
	model = "Qualcomm Technologies, Inc. Pebble RCM + Peach + Pandeiro";
	compatible = "qcom,pebble-rcm", "qcom,pebblep-rcm", "qcom,rcm", "qcom,pebble", "qcom,pebblep";
	qcom,msm-id = <735 0x10000>;
	qcom,board-id = <0x30115 0x0>;
};

