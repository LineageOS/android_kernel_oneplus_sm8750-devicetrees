// SPDX-License-Identifier: BSD-3-Clause
/*
 * Copyright (c) Qualcomm Technologies, Inc. and/or its subsidiaries.
 */

/dts-v1/;
/plugin/;

#include "lahaina-hsp-pro.dtsi"

/ {
	model = "Qualcomm Technologies, Inc. Lahaina HSP-PRO";
	compatible = "qcom,lahaina-cdp", "qcom,lahaina", "qcom,cdp", "qcom,lahaina-qrd",
			 "qcom,qrd", "qcom,lahaina-mtp", "qcom,mtp";
	qcom,msm-id = <415 0x10000>, <456 0x10000>, <501 0x10000>, <415 0x20000>,
			<456 0x20000>, <501 0x20000>, <415 0x20001>, <456 0x20001>,
			<501 0x20001>, <439 0x10000>, <502 0x10000>, <439 0x20000>,
			<502 0x20000>, <439 0x20001>, <502 0x20001>;
	qcom,board-id = <0x3010001 0>, <0x201000B 0>, <0x2010008 0>;
};
