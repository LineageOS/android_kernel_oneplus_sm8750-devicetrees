// SPDX-License-Identifier: BSD-3-Clause

/*
 * Copyright (c) Qualcomm Technologies, Inc. and/or its subsidiaries.
 */

/dts-v1/;
/plugin/;
/include/ "echo-fig-cnss.dtsi"

/ {
	model = "Qualcomm Technologies, Inc. ECHO SoC";
	compatible = "qcom,echo";
	qcom,msm-id = <701 0x10000>, <772 0x10000>;
	qcom,board-id = <0x10022 0x0>, <0x10021 0x0>, <0x20015 0x0>, <0x1010022 0x401>,
			<0x1020022 0x00>, <0x2050022 0x0>, <0x2060022 0x0>, <0x1020022 0x401>;
};
