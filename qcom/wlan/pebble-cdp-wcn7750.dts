// SPDX-License-Identifier: BSD-3-Clause
/*
 * Copyright (c) Qualcomm Technologies, Inc. and/or its subsidiaries.
 */

/dts-v1/;
/plugin/;

#include "pebble-wcn7750.dtsi"

/ {
	model = "Qualcomm Technologies, Inc. Pebble CDP + wcn7750 WLAN";
	compatible = "qcom,pebble-cdp", "qcom,pebblep-cdp", "qcom,cdp", "qcom,pebble", "qcom,pebblep";
	qcom,msm-id = <735 0x10000>, <741 0x10000>;
	qcom,board-id = <0x10101 0x0>;
};
