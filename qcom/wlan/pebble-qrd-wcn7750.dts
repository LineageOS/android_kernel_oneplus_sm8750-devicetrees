// SPDX-License-Identifier: BSD-3-Clause
/*
 * Copyright (c) Qualcomm Technologies, Inc. and/or its subsidiaries.
 */

/dts-v1/;
/plugin/;

#include "pebble-wcn7750.dtsi"

/ {
	model = "Qualcomm Technologies, Inc. Pebble QRD + wcn7750";
	compatible = "qcom,pebble-qrd", "qcom,pebblep-qrd", "qcom,qrd", "qcom,pebble", "qcom,pebblep";
	qcom,msm-id = <735 0x10000>, <741 0x10000>;
	qcom,board-id = <0x1010b 0x0>;
};
