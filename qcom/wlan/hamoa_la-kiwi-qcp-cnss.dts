// SPDX-License-Identifier: BSD-3-Clause

/*
 * Copyright (c) Qualcomm Technologies, Inc. and/or its subsidiaries.
 */

/dts-v1/;
/plugin/;

#include "hamoa_la-kiwi-cnss.dtsi"

/ {
	model = "Qualcomm Technologies, Inc. hamoa la QCP";
	compatible = "qcom,x1e80100-qcp", "qcom,x1e80100", "qcom,qcp";
	qcom,msm-id = <0x22b 0x10000>, <0x22b 0x20000>;
	qcom,board-id = <0x22 0>, <0x22 1>;
};
