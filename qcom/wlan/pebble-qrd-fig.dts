// SPDX-License-Identifier: BSD-3-Clause
/*
 * Copyright (c) Qualcomm Technologies, Inc. and/or its subsidiaries.
 */

/dts-v1/;
/plugin/;

#include "pebble-fig-cnss.dtsi"

/ {
	model = "Qualcomm Technologies, Inc. Pebble QRD + Fig WLAN";
	compatible = "qcom,pebble-qrd", "qcom,pebblep-qrd", "qcom,qrd", "qcom,pebble", "qcom,pebblep";
	qcom,msm-id = <735 0x10000>, <741 0x10000>;
	qcom,board-id = <0x1000b 0x0>, <0x2000b 0x0>, <0x1020b 0x0>;
};
