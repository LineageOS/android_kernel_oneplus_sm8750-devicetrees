/dts-v1/;
/plugin/;
#include <dt-bindings/oplus/hw-id.h>
#include "../display/sun-sde-display-mtp-v8-overlay.dts"
#include "sun-display-overlay-common.dtsi"
#include "piloti-24620-display-sun-overlay.dtsi"

/ {
	model = "Qualcomm Technologies, Inc. Sun MTP,zhufeng";

	oplus,project-id = <24620>;
};
