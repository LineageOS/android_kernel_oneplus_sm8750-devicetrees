/dts-v1/;
/plugin/;
#include <dt-bindings/oplus/hw-id.h>
#include "../display/sun-sde-display-mtp-kiwi-v8-overlay.dts"
#include "sun-display-overlay-common.dtsi"
#include "ktm-24851-display-sun-overlay.dtsi"

/ {
	model = "Qualcomm Technologies, Inc. Sun MTP,ktm";

	oplus,project-id = <24851>;
};
