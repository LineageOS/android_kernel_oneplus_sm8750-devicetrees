// SPDX-License-Identifier: BSD-3-Clause
/*
 * Copyright (c) Qualcomm Technologies, Inc. and/or its subsidiaries.
 */

/dts-v1/;

#include "ravelin-cqm.dtsi"

/ {
	model = "Qualcomm Technologies, Inc. ravelin-cqm SoC";
	compatible = "qcom,ravelin";
	qcom,msm-id = <773 0x10000>;
	qcom,board-id = <0 0>;
};
